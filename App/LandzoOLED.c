#include  "LandzoOLED.h"


/************************************************************************
OLED 一行可以显示16个字符，可以显示8行。
************************************************************************/

#define OLED_SCL  PTE30_OUT
#define OLED_SDA  PTE24_OUT
#define OLED_RST  PTE25_OUT
#define OLED_DC   PTA2_OUT
#define OLED_CS   PTE4_OUT

#define XLevelL		0x00
#define XLevelH		0x10
#define XLevel		((XLevelH&0x0F)*16+XLevelL)
#define Max_Column	128
#define Max_Row		64
#define	Brightness	0xCF

/*
4线SPI使用说明：
VBT 供内部DC-DC电压，3.3~4.3V，如果使用5V电压，为保险起见串一个100~500欧的电阻
VCC 供内部逻辑电压 1.8~6V
GND 地

BS0 低电平
BS1 低电平
BS2 低电平

CS  片选管脚
DC  命令数据选择管脚
RES 模块复位管脚
D0（SCLK） ，时钟脚，由MCU控制
D1（MOSI） ，主输出从输入数据脚，由MCU控制

D2 悬空
D3-D7 ， 低电平 ， 也可悬空，但最好设为低电平
RD  低电平 ，也可悬空，但最好设为低电平
RW  低电平 ，也可悬空，但最好设为低电平
RD  低电平 ，也可悬空，但最好设为低电平
*/

#define X_WIDTH 128
#define Y_WIDTH 64
//======================================
const uint8_t F6x8[][6] =
{
  { 0x00, 0x00, 0x00, 0x00, 0x00, 0x00 },   // sp
  { 0x00, 0x00, 0x00, 0x2f, 0x00, 0x00 },   // !
  { 0x00, 0x00, 0x07, 0x00, 0x07, 0x00 },   // "
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  { 0x14, 0x14, 0x14, 0x14, 0x14, 0x14 }    // horiz lines
};
const uint8_t F14x16_Idx[] =
{
  "向当前速度左右转差进入调试模式欢迎来到集美大学像素点号等待灯塔信号开始比赛出发！最末页结束"
};
const uint8_t F14x16[] = {

0x00,0xFC,0x04,0x04,0xE6,0x25,0x24,0x24,0x24,0xE4,0x04,0x04,0xFC,0x00,
0x00,0x3F,0x00,0x00,0x03,0x02,0x02,0x02,0x02,0x03,0x20,0x20,0x3F,0x00,//"向",0
0x10,0x12,0x14,0x18,0x10,0x10,0x1F,0x10,0x10,0x18,0x14,0xF2,0x00,0x00,
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0x10,0x11,0x09,0x05,0x03,0x01,0x3F,0x01,0x03,0x05,0x09,0x11,0x10,0x00,//"束",4

};

//======================================================
// 128X64I液晶底层驱动[8X16]字体库
// 设计者: powerint
// 描  述: [8X16]西文字符的字模数据 (纵向取模,字节倒序)
// !"#$%&'()*+,-./0123456789:;<=>?@ABCDEFGHIJKLMNOPQRSTUVWXYZ[\]^_`abcdefghijklmnopqrstuvwxyz{|}~
//======================================================
const uint8_t F8X16[]=
{
  0x00,0x00,0x00,0x00,0x00,0x00,0x00,0x00,0x00,0x00,0x00,0x00,0x00,0x00,0x00,0x00,//  0
  0x00,0x00,0x00,0xF8,0x00,0x00,0x00,0x00,0x00,0x00,0x00,0x33,0x30,0x00,0x00,0x00,//! 1
  0x00,0x10,0x0C,0x06,0x10,0x0C,0x06,0x00,0x00,0x00,0x00,0x00,0x00,0x00,0x00,0x00,//" 2
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  0x00,0x06,0x01,0x01,0x02,0x02,0x04,0x04,0x00,0x00,0x00,0x00,0x00,0x00,0x00,0x00,//~ 94
  
};
//数据水平，字节垂直
uint8_t lanzhou96x64[768] = {
  /*
  0X00,0X00,0X00,0X00,0X00,0X00,0X00,0X00,0X00,0X00,0X00,0X00,0X00,0X00,0X00,0X00,
  0X00,0X00,0X80,0X80,0XC0,0XC0,0XC0,0X60,0X60,0X60,0X30,0X30,0X30,0X38,0X18,0X18,
  0X18,0X18,0X0C,0X0C,0X0C,0X0C,0X0C,0X0E,0X0E,0X0E,0X06,0X06,0X06,0X06,0X06,0X06,
  0X06,0X06,0X06,0X06,0X06,0X06,0X06,0X0E,0X0E,0X0C,0X0C,0X0C,0X0C,0X0C,0X1C,0X18,
  0X18,0X18,0X18,0X30,0X30,0X30,0X70,0X60,0X60,0XE0,0XC0,0XC0,0X80,0X80,0X00,0X00,
  0X00,0X00,0X00,0X00,0X00,0X00,0X00,0X00,0X00,0X00,0X00,0X00,0X00,0X00,0X00,0X00,
  0X00,0X00,0X00,0X00,0X00,0X00,0X00,0X80,0XC0,0XE0,0X70,0X30,0X38,0X1C,0X0C,0X06,
  0X07,0X03,0X03,0X01,0X01,0X00,0X00,0X00,0X00,0X00,0X00,0X00,0X00,0X00,0X00,0X00,
  0X00,0X00,0X00,0X00,0X00,0X00,0X80,0X80,0X80,0X00,0X00,0X00,0X00,0X00,0X80,0X80,
  0XF0,0XF8,0XF8,0XF0,0X80,0X00,0X00,0X80,0XE0,0XF0,0XF8,0XFC,0X3C,0X1C,0X0C,0X0C,
  0X1C,0XFC,0XF8,0XF0,0XE0,0X80,0X00,0X00,0X00,0XC0,0XC0,0XC1,0X01,0X03,0X03,0X07,
  0X06,0X0E,0X0C,0X18,0X38,0X70,0X60,0XC0,0X80,0X80,0X00,0X00,0X00,0X00,0X00,0X00,
  0X00,0X00,0XC0,0XF0,0X78,0X1E,0X07,0X33,0X31,0X38,0X78,0XFC,0XFE,0XF6,0XC0,0X80,
  0X00,0X00,0X00,0X00,0XC0,0XC0,0X80,0X00,0XF8,0XFC,0XDE,0X0E,0X0F,0X1E,0XBE,0XFC,
  0XF0,0X06,0XFF,0XFF,0XFF,0XFF,0X03,0X07,0XFF,0XFF,0XFE,0X80,0X1E,0X3F,0XFF,0XFF,
  0XF9,0XF9,0XFF,0XFF,0X7F,0X1F,0X0E,0X7F,0XFF,0XFF,0XFF,0XC1,0X80,0XCE,0XCE,0XC6,
  0XC0,0XFF,0XFF,0XFF,0XFF,0X3F,0X80,0XFC,0XFC,0XFD,0X7D,0X01,0XC0,0XF8,0XF8,0XF0,
  0X70,0X00,0XC0,0X80,0X80,0X80,0X00,0X00,0X01,0X07,0X0E,0X3C,0XF8,0XE0,0X80,0X00,
  0X00,0XFE,0XFF,0X03,0X00,0X00,0X00,0X00,0X00,0X00,0X00,0X01,0X03,0X0F,0X1F,0X7F,
  0XFE,0XFC,0XF0,0XF0,0XF0,0X7F,0X7F,0X3E,0X10,0X03,0X03,0X0F,0X1F,0X1F,0X0F,0X0F,
  0X03,0X04,0X07,0X07,0X07,0X07,0X06,0X00,0X07,0X07,0X07,0X0F,0X1E,0X3F,0X7F,0X7F,
  0X7F,0X79,0X73,0X3F,0X3F,0X1F,0X0E,0X00,0X01,0X03,0X03,0X07,0X07,0X06,0X0E,0X0F,
  0X0F,0X1F,0X3F,0X3D,0X08,0X0C,0X1F,0X1F,0X1F,0X19,0X3C,0X7F,0X7F,0X7F,0XF3,0XF0,
  0XFC,0XFE,0X3F,0X1F,0X07,0X01,0X00,0X00,0X00,0X00,0X00,0X00,0X00,0XCF,0XFF,0X70,
  0X00,0X03,0X1F,0X7E,0XF0,0XC0,0X00,0X00,0X00,0X00,0X00,0X00,0X00,0X00,0X00,0X00,
  0X03,0X03,0X01,0X01,0X00,0X00,0X00,0X00,0XC0,0XC0,0X40,0X40,0X40,0X40,0XF8,0X78,
  0X40,0XC0,0X40,0X58,0X58,0X40,0X40,0X40,0X00,0X00,0X00,0X00,0X00,0X80,0X80,0X80,
  0X00,0X00,0X00,0X00,0X00,0X00,0X60,0XF0,0XE0,0X20,0X20,0X20,0X20,0X30,0X30,0X38,
  0X18,0X10,0X00,0X00,0X00,0X00,0X00,0X00,0X00,0X00,0X00,0X00,0X00,0X00,0X00,0X01,
  0X01,0X01,0X00,0X00,0X00,0X00,0X00,0X00,0X00,0X00,0X80,0XE0,0XF8,0X3F,0X0F,0X00,
  0X00,0X00,0X00,0X00,0X00,0X03,0X07,0X0E,0X1C,0X38,0X30,0X60,0XE0,0XC0,0X80,0X00,
  0X00,0X00,0X00,0X00,0X00,0X00,0X40,0X60,0X60,0X70,0X30,0X18,0X0C,0X07,0X11,0X08,
  0X3F,0X7D,0X66,0XE7,0XE3,0XC0,0XC0,0XC0,0XE0,0X60,0X00,0X00,0X00,0X03,0X03,0X03,
  0X00,0X00,0X60,0X60,0X60,0X60,0X60,0X7F,0X7F,0X61,0X61,0X61,0X61,0X7F,0X7F,0X61,
  0X61,0XE1,0XE0,0XE0,0XC0,0XC0,0X00,0X00,0X00,0X00,0X00,0X00,0X00,0X00,0X00,0X00,
  0X00,0X80,0XC0,0XC0,0XE0,0X70,0X38,0X18,0X0C,0X07,0X03,0X01,0X00,0X00,0X00,0X00,
  0X00,0X00,0X00,0X00,0X00,0X00,0X00,0X00,0X00,0X00,0X00,0X00,0X00,0X01,0X01,0X03,
  0X03,0X06,0X06,0X0C,0X0C,0X18,0X18,0X38,0X30,0X30,0X70,0X60,0X60,0XE0,0XC0,0XC0,
  0XC0,0XC0,0XC0,0X80,0X80,0X80,0X81,0X80,0X80,0X80,0X80,0X80,0X00,0X00,0X00,0X00,
  0X00,0X00,0X00,0X00,0X80,0X80,0X80,0X80,0X80,0X80,0X80,0X80,0X80,0X80,0XC0,0XC0,
  0XC0,0XC0,0XC0,0X60,0X60,0X60,0X30,0X30,0X30,0X18,0X18,0X1C,0X0C,0X0E,0X06,0X07,
  0X03,0X03,0X01,0X00,0X00,0X00,0X00,0X00,0X00,0X00,0X00,0X00,0X00,0X00,0X00,0X00,
  0X00,0X00,0X00,0X00,0X00,0X00,0X00,0X00,0X00,0X00,0X00,0X00,0X00,0X00,0X00,0X00,
  0X00,0X00,0X00,0X00,0X00,0X00,0X00,0X00,0X00,0X00,0X00,0X00,0X00,0X00,0X00,0X00,
  0X00,0X00,0X01,0X01,0X01,0X01,0X01,0X01,0X01,0X03,0X03,0X03,0X03,0X03,0X03,0X03,
  0X03,0X03,0X03,0X03,0X03,0X03,0X03,0X01,0X01,0X01,0X01,0X01,0X01,0X01,0X00,0X00,
  0X00,0X00,0X00,0X00,0X00,0X00,0X00,0X00,0X00,0X00,0X00,0X00,0X00,0X00,0X00,0X00,
  0X00,0X00,0X00,0X00,0X00,0X00,0X00,0X00,0X00,0X00,0X00,0X00,0X00,0X00,0X00,0X00, */
  
  0x00,0x00,0x00,0x00,0x00,0x00,0x00,0x00,0x00,0x00,0x00,0x00,0x00,0x00,0x00,0x00,
  0x00,0x00,0x00,0x00,0x00,0x00,0x00,0x00,0x00,0x00,0x00,0x00,0x00,0x00,0x00,0x00,
  0x00,0x00,0x00,0x00,0x00,0x00,0x00,0x00,0x00,0x00,0x00,0x00,0x00,0x00,0x00,0x00,
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  0x00,0x00,0x00,0x00,0x00,0x00,0x00,0x00,0x00,0x00,0x00,0x00,0x00,0x00,0x00,0x00,
  
};
const uint8_t LIBLOGO60x58[480] = {
  0X00,0X00,0X00,0X00,0X00,0X00,0X00,0X00,0X00,0X00,0X00,0X00,0X00,0X00,0X00,0X00,
  0X00,0X00,0X00,0X00,0X00,0X00,0X00,0X00,0X00,0X00,0X00,0X00,0X00,0X00,0X00,0X00,
  0X00,0X00,0X00,0X00,0X00,0X00,0X00,0X00,0X00,0X00,0X00,0X00,0X00,0X00,0X00,0X00,
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  0X00,0X00,0X00,0X00,0X00,0X00,0X00,0X00,0X00,0X00,0X00,0X00,0X00,0X00,0X00,0X00,
};
uint8_t LANDZO_LOGO[300] ={
  0x00,0x00,0x00,0x00,0x00,0x00,0x00,0x00,0x80,0xC0,0xC0,0x60,0x30,0x10,0x18,0x08,
  0x04,0x14,0x10,0x1A,0x18,0x18,0x1C,0x1C,0x1C,0x1C,0x3C,0x3C,0x3C,0x3C,0x7C,0x7C,
  0xFC,0xFC,0xF8,0xF8,0xF0,0xF0,0xE0,0xE0,0xC0,0x80,0x00,0x00,0x00,0x00,0x00,0x00,
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  0x04,0x02,0x01,0x00,0x00,0x00,0x00,0x00,0x00,0x00,0x00,0x00
};

uint8_t QQ[480]={
0x00,0x00,0x00,0x00,0x00,0x00,0x00,0x00,0x00,0x00,0x00,0x00,0x00,0x00,
0x00,0x00,0x00,0x00,0x00,0x00,0x00,0x00,0x00,0x00,0x00,0x00,0x00,0x00,
0x00,0x00,0x00,0x00,0x00,0x00,0x00,0x00,0x00,0x00,0x00,0x00,0x00,0x00,
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0x00,0x00,0x00,0x00,};

uint8_t BMP[]={
0xFF,0xFF,0xFF,0xFF,0xFF,0xFF,0xFF,0xFF,0xFF,0xFF,0xFF,0xFF,0xFF,0xFF,
0xFF,0xFF,0xFF,0xFF,0xFF,0xFF,0xFF,0xFF,0xFF,0xFF,0xFF,0xFF,0xFF,0xFF,
0xFF,0xFF,0xFF,0xFF,0xFF,0xFF,0xFF,0xFF,0x7F,0x7F,0x7F,0x7F,0x7F,0x7F,
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0xFF,0xFF,0xFF,0xFF,0xFF,0xFF,0xFF,0xFF,/*"",0*/
};
/*************************************************************************
*                           蓝宙电子工作室
*
*  函数名称：Dly_ms
*  功能说明：延时函数
*  参数说明： ms
*  函数返回：无
*  修改时间：2014-9-13
*  备    注：
*************************************************************************/
void Dly_ms(uint16_t ms)
{
  uint16_t ii,jj;
  if (ms<1) ms=1;
  ms = ms*12 ;
  for(ii=0;ii<ms;ii++)
    for(jj=0;jj<1335;jj++);  //16MHz--1ms
  //   for(jj=0;jj<4006;jj++);  //48MHz--1ms
  //for(jj=0;jj<5341;jj++);    //64MHz--1ms
}

/*************************************************************************
*                           蓝宙电子工作室
*
*  函数名称：OLED_WrDat
*  功能说明：写数据函数
*  参数说明： data
*  函数返回：无
*  修改时间：2014-9-13
*  备    注：
*************************************************************************/
void OLED_WrDat(uint8_t data)
{
  uint8_t i=8;
  
  OLED_DC=1;
  OLED_SCL=0;
  while(i--)
  {
    if(data&0x80){OLED_SDA=1;}
    else{OLED_SDA=0;}
    OLED_SCL=1;
    asm("nop");
    OLED_SCL=0;
    data<<=1;
  }
}

/*************************************************************************
*                           蓝宙电子工作室
*
*  函数名称：OLED_Wr6Dat
*  功能说明：写数6位据函数
*  参数说明： data
*  函数返回：无
*  修改时间：2014-9-13
*  备    注：
*************************************************************************/
void OLED_Wr6Dat(uint8_t data)
{
  uint8_t i=6;
  
  OLED_DC=1;
  OLED_SCL=0;
  while(i--)
  {
    if(data&0x80){OLED_SDA=1;}
    else{OLED_SDA=0;}
    OLED_SCL=1;
    asm("nop");
    OLED_SCL=0;
    data<<=1;
  }
}

/*************************************************************************
*                           蓝宙电子工作室
*
*  函数名称：OLED_WrCmd
*  功能说明：写数命令函数
*  参数说明： cmd
*  函数返回：无
*  修改时间：2014-9-13
*  备    注：
*************************************************************************/
void OLED_WrCmd(uint8_t cmd)
{
  uint8_t i=8;

  OLED_DC=0;;
  OLED_SCL=0;;

  while(i--)
  {
    if(cmd&0x80){OLED_SDA=1;}
    else{OLED_SDA=0;}
    OLED_SCL=1;
    asm("nop");

    OLED_SCL=0;
    cmd<<=1;
  }
  
}

/*************************************************************************
*                           蓝宙电子工作室
*
*  函数名称：OLED_Set_Pos
*  功能说明：设置位置函数
*  参数说明： x
*             y
*  函数返回：无
*  修改时间：2014-9-13
*  备    注：
*************************************************************************/
void OLED_Set_Pos(uint8_t x, uint8_t y)
{
  OLED_WrCmd(0xb0+y);
  OLED_WrCmd(((x&0xf0)>>4)|0x10);
  OLED_WrCmd((x&0x0f)|0x01);
}

/*************************************************************************
*                           蓝宙电子工作室
*
*  函数名称：OLED_Fill
*  功能说明：填充函数
*  参数说明： bmp_data   
*  函数返回：无
*  修改时间：2014-9-13
*  备    注：
*************************************************************************/
void OLED_Fill(uint8_t bmp_data)
{
  uint8_t y,x;
  
  for(y=0;y<8;y++)
  {
    OLED_WrCmd(0xb0+y);
    OLED_WrCmd(0x01);
    OLED_WrCmd(0x10);
    for(x=0;x<X_WIDTH;x++)
      OLED_WrDat(bmp_data);
  }
}

/*************************************************************************
*                           蓝宙电子工作室
*
*  函数名称：OLED_CLS
*  功能说明：清除函数
*  参数说明： 无 
*  函数返回：无
*  修改时间：2014-9-13
*  备    注：
*************************************************************************/
void OLED_CLS(void)
{
  uint8_t y,x;
  for(y=0;y<8;y++)
  {
    OLED_WrCmd(0xb0+y);
    OLED_WrCmd(0x01);
    OLED_WrCmd(0x10);
    for(x=0;x<X_WIDTH;x++)
      OLED_WrDat(0);
  }
}

/*************************************************************************
*                           蓝宙电子工作室
*
*  函数名称：OLED_DLY_ms
*  功能说明：延时函数
*  参数说明：ms
*  函数返回：无
*  修改时间：2014-9-13
*  备    注：
*************************************************************************/
void OLED_DLY_ms(uint16_t ms)
{
  uint16_t a;
  while(ms)
  {
    a=16000;
    while(a--);
    ms--;
  }
  return;
}

/*************************************************************************
*                           蓝宙电子工作室
*
*  函数名称：OLED_Init
*  功能说明：初始化函数
*  参数说明：无
*  函数返回：无
*  修改时间：2014-9-13
*  备    注：
*************************************************************************/
void OLED_Init(void)
{
  gpio_init (PTE30, GPO,HIGH);
  gpio_init (PTE24, GPO,HIGH);
  gpio_init (PTA2, GPO,HIGH);
  gpio_init (PTE25, GPO,LOW);
  
  OLED_SCL=1;
  OLED_CS = 0 ; ///使能信号端，拉低时正常使用
  OLED_RST=0;
  OLED_DLY_ms(50);
  OLED_RST=1;
  
  OLED_WrCmd(0xae);//--turn off oled panel
  OLED_WrCmd(0x00);//---set low column address
  OLED_WrCmd(0x10);//---set high column address
  OLED_WrCmd(0x40);//--set start line address  Set Mapping RAM Display Start Line (0x00~0x3F)
  OLED_WrCmd(0x81);//--set contrast control register
  OLED_WrCmd(0xcf); // Set SEG Output Current Brightness
  OLED_WrCmd(0xa1);//--Set SEG/Column Mapping     0xa0左右反置 0xa1正常
  OLED_WrCmd(0xc8);//Set COM/Row Scan Direction   0xc0上下反置 0xc8正常
  OLED_WrCmd(0xa6);//--set normal display
  OLED_WrCmd(0xa8);//--set multiplex ratio(1 to 64)
  OLED_WrCmd(0x3f);//--1/64 duty
  OLED_WrCmd(0xd3);//-set display offset	Shift Mapping RAM Counter (0x00~0x3F)
  OLED_WrCmd(0x00);//-not offset
  OLED_WrCmd(0xd5);//--set display clock divide ratio/oscillator frequency
  OLED_WrCmd(0x80);//--set divide ratio, Set Clock as 100 Frames/Sec
  OLED_WrCmd(0xd9);//--set pre-charge period
  OLED_WrCmd(0xf1);//Set Pre-Charge as 15 Clocks & Discharge as 1 Clock
  OLED_WrCmd(0xda);//--set com pins hardware configuration
  OLED_WrCmd(0x12);
  OLED_WrCmd(0xdb);//--set vcomh
  OLED_WrCmd(0x40);//Set VCOM Deselect Level
  OLED_WrCmd(0x20);//-Set Page Addressing Mode (0x00/0x01/0x02)
  OLED_WrCmd(0x02);//
  OLED_WrCmd(0x8d);//--set Charge Pump enable/disable
  OLED_WrCmd(0x14);//--set(0x10) disable
  OLED_WrCmd(0xa4);// Disable Entire Display On (0xa4/0xa5)
  OLED_WrCmd(0xa6);// Disable Inverse Display On (0xa6/a7)
  OLED_WrCmd(0xaf);//--turn on oled panel
  OLED_Fill(0x00);  //初始清屏
  OLED_Set_Pos(0,0);
  
 //  OLED_Fill(0x00);//黑屏 
  // OLED_DLY_ms(100); 
 //OLED_Print_Str(30,2,"开始比赛");  //汉字字符串显示
//  Draw_LibLogo();
 // OLED_Print_Str(40,6,"出发！"); 
//Draw_BMP(0,0,64,7,BMP);

}

/*************************************************************************
*                           蓝宙电子工作室
*
* 函数名： void OLED_PutPixel(uint8_t x,uint8_t y)
* 功能描述：绘制一个点（x,y）
* 参数：真实坐标值(x,y),x的范围0～127，y的范围0～64
* 返回：无
*************************************************************************/
void OLED_PutPixel(uint8_t x,uint8_t y)
{
  uint8_t data1;  //data1当前点的数据
  
  OLED_Set_Pos(x,y);
  data1 = 0x01<<(y%8);
  OLED_WrCmd(0xb0+(y>>3));
  OLED_WrCmd(((x&0xf0)>>4)|0x10);
  OLED_WrCmd((x&0x0f)|0x00);
  OLED_WrDat(data1);
}
/*************************************************************************
*                           蓝宙电子工作室
*
* 函数名： void OLED_Rectangle(uint8_t x1,uint8_t y1,
                   uint8_t x2,uint8_t y2,uint8_t color,uint8_t gif)
* 功能描述：绘制一个实心矩形
* 参数：左上角坐标（x1,y1）,右下角坐标（x2，y2）
      其中x1、x2的范围0～127，y1，y2的范围0～63，即真实坐标值
* 返回：无
*************************************************************************/
void OLED_Rectangle(uint8_t x1,uint8_t y1,uint8_t x2,uint8_t y2,uint8_t gif)
{
  uint8_t n;
  
  OLED_Set_Pos(x1,y1>>3);
  for(n=x1;n<=x2;n++)
  {
    OLED_WrDat(0x01<<(y1%8));
    if(gif == 1) 	
      OLED_DLY_ms(50);
  }
  OLED_Set_Pos(x1,y2>>3);
  for(n=x1;n<=x2;n++)
  {
    OLED_WrDat(0x01<<(y2%8));
    if(gif == 1) 	
      OLED_DLY_ms(5);
  }
  
}
/*************************************************************************
*                           蓝宙电子工作室
*
//函数名：LCD_P6x8Str(uint8_t x,uint8_t y,uint8_t *p)
//功能描述：写入一组标准ASCII字符串
//参数：显示的位置（x,y），y为页范围0～7，要显示的字符串
//返回：无
*************************************************************************/
void OLED_P6x8Str(uint8_t x,uint8_t y,uint8_t ch[])
{
  uint8_t c=0,i=0,j=0;
  while (ch[j]!='\0')
  {
    c =ch[j]-32;
    if(x>126){x=0;y++;}
    OLED_Set_Pos(x,y);
    for(i=0;i<6;i++)
      OLED_WrDat(F6x8[c][i]);
    x+=6;
    j++;
  }
}
/*************************************************************************
*                           蓝宙电子工作室
*
* 函数名：LCD_P8x16Str(uint8_t x,uint8_t y,uint8_t *p)
* 功能描述：写入一组标准ASCII字符串
* 参数：显示的位置（x,y），y为页范围0～7，要显示的字符串
* 返回：无
*************************************************************************/
void OLED_P8x16Str(uint8_t x,uint8_t y,uint8_t ch[])
{
  uint8_t c=0,i=0,j=0;
  
  while (ch[j]!='\0')
  {
    c =ch[j]-32;
    if(x>120){x=0;y++;}
    OLED_Set_Pos(x,y);
    for(i=0;i<8;i++)
      OLED_WrDat(F8X16[c*16+i]);
    OLED_Set_Pos(x,y+1);
    for(i=0;i<8;i++)
      OLED_WrDat(F8X16[c*16+i+8]);
    x+=8;
    j++;
  }
}

/*********************************************************** 
* 函数功能：显示14X16字体
* 函数名称：OLED_P14x16Str
* 入口参数：x :   行位置
*           y :  列位置
*          ch ： 字体数组
* 出口参数：无 
* 修改时间: 2014-08-18
* 备 注： 
***********************************************************/

void OLED_P14x16Str(uint8_t x,uint8_t y,uint8_t ch[])
{
  uint8_t wm=0,ii = 0;
  uint16_t adder=1;
  
  while(ch[ii] != '\0')
  {
    wm = 0;
    adder = 1;
    while(F14x16_Idx[wm] > 127)
    {
      if(F14x16_Idx[wm] == ch[ii])
      {
        if(F14x16_Idx[wm + 1] == ch[ii + 1])
        {
          adder = wm * 14;
          break;
        }
      }
      wm += 2;
    }
    if(x>118){x=0;y++;}
    OLED_Set_Pos(x , y);
    if(adder != 1)// 显示汉字
    {
      OLED_Set_Pos(x , y);
      for(wm = 0;wm < 14;wm++)
      {
        OLED_WrDat(F14x16[adder]);
        adder += 1;
      }
      OLED_Set_Pos(x,y + 1);
      for(wm = 0;wm < 14;wm++)
      {
        OLED_WrDat(F14x16[adder]);
        adder += 1;
      }
    }
    else			  //显示空白字符
    {
      ii += 1;
      OLED_Set_Pos(x,y);
      for(wm = 0;wm < 16;wm++)
      {
        OLED_WrDat(0);
      }
      OLED_Set_Pos(x,y + 1);
      for(wm = 0;wm < 16;wm++)
      {
        OLED_WrDat(0);
      }
    }
    x += 14;
    ii += 2;
  }
}

/*********************************************************** 
* 函数功能：数字转换成ACSII
* 入口参数：hex :   需要显示的数
*           Print : 转换后的数组指针
* 出口参数：无 
* 修改时间: 2014-08-18
* 备 注： 
***********************************************************/

void OLED_HEXACSII(uint16_t hex,uint8_t* Print)
{
  uint8_t hexcheck ;
  uint8_t TEMP ;
  TEMP = 6 ;
  Print[TEMP ]='\0';
  while(TEMP)
  {
    TEMP -- ;
    hexcheck  =  hex%10 ;
    hex   /=10 ;
    Print[TEMP ]  = hexcheck + 0x30 ;
  }
  
}

/*********************************************************** 
* 函数名称：OLED_Print_Num
* 函数功能：数字显示
* 入口参数：x : 角度显示字符
*           y : 加速度显示字符
*          num: 显示的数字
* 出口参数：无 
* 修改时间: 2014-08-18
* 备 注： 
***********************************************************/
void OLED_Print_Num(uint8_t x, uint8_t y, uint16_t num)
{
  uint8_t *ch1,ch[7];
  uint8_t ii=0;
  
  OLED_HEXACSII(num,ch);
  
  while(ch[ii]==0x30)
  {
      ii++;
  }
  
  ch1 =&ch[ii];
  
  while(*ch1 != '\0')
  {
      OLED_P8x16Str(x, y, ch1);	//显示数字
      x += 8;
     ch1++;
  }
}

/*********************************************************** 
* 函数名称：OLED_Print_Str
* 函数功能：字符显示
* 入口参数：x : 位置
*           y : 位置
*          ch: 显示的字符串数组
* 出口参数：无 
* 修改时间: 2014-08-18
* 备 注： 
***********************************************************/
void OLED_Print_Str(uint8_t x, uint8_t y, uint8_t ch[])
{
  uint8_t ch2[3];
  uint8_t ii=0;
  while(ch[ii] != '\0')
  {
    if(ch[ii] > 127)
    {
      ch2[0] = ch[ii];
      ch2[1] = ch[ii + 1];
      ch2[2] = '\0';			//汉字为两个字节
      OLED_P14x16Str(x , y, ch2);	//显示汉字
      x += 14;
      ii += 2;
    }
    else
    {
      ch2[0] = ch[ii];
      ch2[1] = '\0';			//字母占一个字节
      OLED_P8x16Str(x , y , ch2);	//显示字母
      x += 8;
      ii+= 1;
    }
  }
}

/*********************************************************** 
* 函数名： void Draw_BMP(uint8_t x,uint8_t y)
* 功能描述：显示BMP图片128×64
* 参数：起始点坐标(x,y),x的范围0～127，y为页的范围0～7
* 返回：无
***********************************************************/
void Draw_BMP(uint8_t x0,uint8_t y0,uint8_t x1,uint8_t y1,uint8_t bmp[])
{
  uint16_t ii=0;
  uint8_t x,y;
  
  if(y1%8==0) y=y1/8;
  else y=y1/8+1;
  for(y=y0;y<=y1;y++)
  {
    OLED_Set_Pos(x0,y);
    for(x=x0;x<x1;x++)
    {
      OLED_WrDat(bmp[ii++]);
    }
  }
}

void Draw_LibLogo(void)
{
  uint16_t ii=0;
  uint8_t x,y;
  
  for(y=0;y<8;y++)
  {
    OLED_Set_Pos(34,y);
    for(x=34;x<94;x++)
    {
       OLED_WrDat(QQ[ii++]);
    //  OLED_WrDat(LIBLOGO60x58[ii++]);
    }
  }
}

void Draw_Landzo(void)
{
  uint16_t ii=0;
  uint8_t x,y;
  
  for(y=2;y<8;y++)
  {
    OLED_Set_Pos(40,y);
    for(x=40;x<90;x++)
    {
      OLED_WrDat(LANDZO_LOGO[ii++]);
    }
  }
}

void Dis_Float(unsigned char Y,unsigned char X,double real,unsigned char N) 
{
   unsigned char   i_Count=1;
   unsigned char   n[12]={0};
   long   j=1;  
   uint16_t   real_int=0;
   double decimal=0;
   uint16_t   real_decimal=0;
   X=X*8;
   real_int=(int)real;
   //Dis_Num(2,0,real_int,5);
   decimal=real-real_int;
   real_decimal=decimal*1e4;
   //Dis_Num(2,6,real_decimal,4);
   while(real_int/10/j!=0)
   {
      j=j*10;i_Count++;  
   } 
   n[0]=(real_int/10000)%10; 
   n[1]=(real_int/1000)%10;
   n[2]=(real_int/100)%10;
   n[3]=(real_int/10)%10;
   n[4]=(real_int/1)%10; 
   n[5]='.';
   n[6]=(real_decimal/1000)%10;
   n[7]=(real_decimal/100)%10;
   n[8]=(real_decimal/10)%10;
   n[9]=real_decimal%10;
   n[6+N]='\0'; 
   for(j=0;j<10;j++) n[j]=n[j]+16+32;
   n[5]='.';
   n[6+N]='\0';   
   OLED_Print_Str(X,Y,&n[5-i_Count]); 
}

void Dis_Float2(unsigned char Y,unsigned char X,double real,unsigned char N1,unsigned char N2) 
{
//   byte   i_Count=1;
//   byte   n[12]={0};
   unsigned char   i_Count=1;
   unsigned char   n[12]={0};
   long   j=1;  
   uint16_t   real_int=0;
   double decimal=0;
   uint16_t   real_decimal=0;
   X=X*8;
   real_int=(int)real;
   //Dis_Num(2,0,real_int,5);
   decimal=real-real_int;
   real_decimal=decimal*1e4;
   //Dis_Num(2,6,real_decimal,4);
   while(real_int/10/j!=0)
   {
      j=j*10;i_Count++;  
   } 
   n[0]=(real_int/10000)%10; 
   n[1]=(real_int/1000)%10;
   n[2]=(real_int/100)%10;
   n[3]=(real_int/10)%10;
   n[4]=(real_int/1)%10; 
   n[5]='.';
   n[6]=(real_decimal/1000)%10;
   n[7]=(real_decimal/100)%10;
   n[8]=(real_decimal/10)%10;
   n[9]=real_decimal%10;
   n[6+N2]='\0'; 
   for(j=0;j<10;j++) n[j]=n[j]+16+32;
   n[5]='.';
   n[6+N2]='\0';   
   OLED_Print_Str(X,Y,&n[5-N1]); 
}

void Dis_SNum(uint8 x, uint8 y, uint16 num,uint8 N)
{
  uint8 j=0;
  uint8 n[6]={0};
  x=x*8;
  n[0]=(num/10000)%10; 
  n[1]=(num/1000)%10;
  n[2]=(num/100)%10;
  n[3]=(num/10)%10;
  n[4]=num%10;
 // n[6]='\0';
  for(j=0;j<5;j++) n[j]=n[j]+16+32;
  OLED_P6x8Str(x,y,&n[5-N]);//从ACSII码表中读取字节，然后写入液晶


}

void OLED_IMG(uint8 (*tempimg)[128],uint16 center)
{
  uint8 i,j,x;
  OLED_P6x8Str(4,0,"Center_Line");
  Dis_SNum(43,0,center,2);
    for(i=1; i<=6; i++)//6次循环完成56*80的图像区
        {
          OLED_Set_Pos(0,i);
            for(j=0; j<128; j++)//一次循环完成一个36*128的图像去
            {
//                 x = tempimg[i*8][j]
//                    +tempimg[i*8+1][j]*2
//                        +tempimg[i*8+2][j]*4
//                            +tempimg[i*8+3][j]*8
//                                +tempimg[i*8+4][j]*16
//                                    +tempimg[i*8+5][j]*32
//                                        +tempimg[i*8+6][j]*64
//                                            +tempimg[i*8+7][j]*128;//将竖着的8个像素合并成一个字节
					  x = tempimg[16+4*(i-1)][j]
                    +tempimg[16+4*(i-1)][j]*2
                        +tempimg[16+4*(i-1)+1][j]*4
                            +tempimg[16+4*(i-1)+1][j]*8
                                +tempimg[16+4*(i-1)+2][j]*16
                                    +tempimg[16+4*(i-1)+2][j]*32
                                        +tempimg[16+4*(i-1)+3][j]*64
                                            +tempimg[16+4*(i-1)+3][j]*128;//将竖着的8个像素合并成一个字节 
                           OLED_WrDat(x);
            }    
			 
		
        }
        
        //上面的一段程序完成了36行像素的显示，同理，下面显示剩下4行
//        OLED_Set_Pos(0,5);
//        for(j=0; j<128; j++)
//        {
//             x = tempimg[38][j]
//                +tempimg[39][j]*2;
////                    +tempimg[37][j]*4
////                        +tempimg[38][j]*8
////								  +tempimg[39][j]*16;
//             OLED_WrDat(x);
//        }	
}



